// // Original code from https://github.com/agra-uni-bremen/sifive-hifive1
/*
 * font.c
 *
 *  Created on: 19 Sep 2019
 *      Author: dwd
 */

#include "font.h"
#include "display.h"

static uint8_t font[FONT_N][FONT_W] = {
  {0x00, 0x7e, 0x7e, 0x7e, 0x00, 0x00},
  {0x10, 0x38, 0x7c, 0x3e, 0x1c, 0x08},
  {0x1c, 0x1c, 0x1c, 0x1c, 0x1c, 0x1c},
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  {0x10, 0x18, 0x14, 0x12, 0x14, 0x18},
};

static unsigned col = 0;
static unsigned row = 0;


/** Go to new line */
void newline()
{
    /* Pad current line to end, if necessary */
    for (; col < DISP_W; ++col) {
        spi(0);
    }
    col = 0;
    /* Go to next row */
    row = (row + 1)%(DISP_H/2);
    set_xrow(0, row);
    /* Clear it */
    for (unsigned x=0; x<DISP_W; ++x) {
        spi(0);
    }
    /* Go back to row */
    set_x(0);
}

/* write a character to OLED screen.
 * must be in data mode.
 */
void printChar(uint8_t ch)
{
	mode_data();
    if(ch == '\n' || ch == '\r')
    {
    	newline();
    	return;
    }

    unsigned x;
    if (col > (DISP_W - CHAR_W)) { /* At end of line */
      newline();
    }

    if (ch >= FONT_N) {
        ch = 0;
    }
    for (x=0; x<FONT_W; ++x) {
        spi(font[ch][x]);
    }
    for (; x<CHAR_W; ++x) { /* Pad with empty columns if necessary */
        spi(0);
    }
    col += CHAR_W;
}

void cls()
{
	oled_clear();
	row = 0;
	col = 0;
	set_xrow(0,0);
}

void printText(const char* text)
{
	while (*text != '\0'){
		printChar(*text++);
	}
}
